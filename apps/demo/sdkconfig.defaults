## components/esp32qjs_interactive/Kconfig.projbuild
```kconfig
menu "ESP32QJS Interaction"

config ESP32QJS_REPL_DISPLAY_COLUMNS
    int "Serial monitor display columns"
    depends on ESP32QJS_ENABLE_REPL
    range 40 240
    default 80
    help
        Logical display width used by the line editor when restoring wrapped
        prompts. Match this to the serial monitor width when needed.

endmenu
```

## components/esp32qjs_runtime/Kconfig.projbuild
```kconfig
menu "ESP32QJS Runtime"

config ESP32QJS_ENABLE_REPL
    bool "Enable serial JavaScript REPL"
    default y
    help
        Enable the USB Serial/JTAG REPL frontend. Disable this for headless or
        production firmware that should only run the selected application.

config ESP32QJS_JS_HEAP_SIZE
    int "JavaScript heap size (bytes)"
    range 65536 4194304
    default 163840
    help
        Size of the dedicated heap buffer passed to mquickjs.

config ESP32QJS_JS_HEAP_PREFER_PSRAM
    bool "Prefer PSRAM for the JavaScript heap"
    default y
    help
        Try PSRAM first and fall back to internal memory.

config ESP32QJS_LITTLEFS_FORMAT_ON_MOUNT_FAIL
    bool "Format LittleFS when mount fails"
    default n
    help
        Development convenience that may erase application data. Production
        profiles should leave this disabled.

config ESP32QJS_SECONDARY_LITTLEFS
    bool "Mount a secondary LittleFS partition"
    depends on ESP32_MQUICKJS_FEATURE_FS
    default n
    help
        Mount a second application-defined LittleFS partition. The runtime
        only provides the mount; application code decides whether and when to
        select it as the active filesystem root.

config ESP32QJS_SECONDARY_LITTLEFS_PARTITION_LABEL
    string "Secondary LittleFS partition label"
    depends on ESP32QJS_SECONDARY_LITTLEFS
    default "data"

config ESP32QJS_SECONDARY_LITTLEFS_BASE_PATH
    string "Secondary LittleFS base path"
    depends on ESP32QJS_SECONDARY_LITTLEFS
    default "/data"

config ESP32QJS_SECONDARY_LITTLEFS_REQUIRED
    bool "Require the secondary LittleFS partition"
    depends on ESP32QJS_SECONDARY_LITTLEFS
    default y
    help
        Treat a secondary filesystem mount failure as a guarded startup
        failure. When startup guarding reaches its configured failure limit,
        the runtime starts in safe mode without the secondary filesystem so
        application recovery services can remain available.

config ESP32QJS_AUTORUN_INDEX_JS
    bool "Auto-run /littlefs/index.js at boot"
    default y

config ESP32QJS_RUNTIME_TASK_STACK_SIZE
    int "JavaScript runtime task stack size (bytes)"
    range 4096 32768
    default 8192

config ESP32QJS_RUNTIME_TASK_PRIORITY
    int "JavaScript runtime task priority"
    range 1 24
    default 1

config ESP32QJS_RUNTIME_STOP_TIMEOUT_MS
    int "Default runtime stop timeout (ms)"
    range 100 30000
    default 5000

config ESP32QJS_RUNTIME_RESTART_TIMEOUT_MS
    int "JavaScript runtime restart drain timeout (ms)"
    range 100 30000
    default 5000
    help
        Bound cancellation and native-driver draining before a JavaScript
        generation is replaced.

choice ESP32QJS_RUNTIME_RESTART_FAILURE_ACTION
    prompt "Runtime restart failure action"
    default ESP32QJS_RUNTIME_RESTART_FAILURE_REBOOT

config ESP32QJS_RUNTIME_RESTART_FAILURE_REBOOT
    bool "Reboot the device"

config ESP32QJS_RUNTIME_RESTART_FAILURE_STOP
    bool "Stop the JavaScript runtime"

endchoice

config ESP32QJS_RUNTIME_TASK_WATCHDOG
    bool "Subscribe the JavaScript runtime task to the task watchdog"
    default y if ESP_TASK_WDT_EN
    depends on ESP_TASK_WDT_EN
    help
        Use the ESP-IDF task watchdog as a final recovery layer. JavaScript
        callback deadlines should normally interrupt runaway code first.

config ESP32QJS_RUNTIME_JS_WATCHDOG
    bool "Watch outer JavaScript scheduler progress"
    default y if ESP_TASK_WDT_EN
    depends on ESP_TASK_WDT_EN
    help
        Subscribe an independent task-watchdog user that is fed only after the
        runtime returns to its outer scheduler or while a framework-owned
        native wait cooperates with that scheduler. Tight JavaScript that never
        enters a native wait still cannot conceal a turn that never returns.

config ESP32QJS_RUNTIME_STARTUP_GUARD
    bool "Track startup failures and expose persistent safe mode"
    default y
    help
        Count watchdog, panic, and uncaught startup-script failures. Two
        consecutive failures latch sys.safeMode until it is explicitly
        cleared. Applications decide what safe mode skips.

config ESP32QJS_RUNTIME_STARTUP_FAILURE_LIMIT
    int "Consecutive startup failures before safe mode"
    depends on ESP32QJS_RUNTIME_STARTUP_GUARD
    range 1 10
    default 2

config ESP32QJS_RUNTIME_STARTUP_HEALTHY_MS
    int "Healthy outer-scheduler window (ms)"
    depends on ESP32QJS_RUNTIME_STARTUP_GUARD
    range 1000 300000
    default 30000

endmenu
```

## configs/boards/esp32c3_supermini/sdkconfig.defaults
```kconfig
CONFIG_PARTITION_TABLE_CUSTOM=y
CONFIG_PARTITION_TABLE_CUSTOM_FILENAME="configs/boards/esp32c3_supermini/partitions.csv"
CONFIG_PARTITION_TABLE_FILENAME="configs/boards/esp32c3_supermini/partitions.csv"

CONFIG_MBEDTLS_X509_TRUSTED_CERT_CALLBACK=y
CONFIG_MBEDTLS_CERTIFICATE_BUNDLE_CROSS_SIGNED_VERIFY=y

CONFIG_ESPTOOLPY_HEADER_FLASHSIZE_UPDATE=y
CONFIG_ESPTOOLPY_FLASHSIZE_4MB=y
CONFIG_ESPTOOLPY_FLASHSIZE="4MB"

CONFIG_ESP_CONSOLE_USB_SERIAL_JTAG=y
CONFIG_ESP_CONSOLE_SECONDARY_NONE=y
CONFIG_ESP_CONSOLE_USB_SERIAL_JTAG_ENABLED=y
CONFIG_ESP_CONSOLE_UART_NUM=-1
CONFIG_ESP_CONSOLE_ROM_SERIAL_PORT_NUM=4

CONFIG_ESP32QJS_JS_HEAP_SIZE=98304
CONFIG_ESP32_MQUICKJS_BOARD_NAME="ESP32-C3 SuperMini"
CONFIG_ESP32_MQUICKJS_USER_LED_PIN=8
CONFIG_ESP32_MQUICKJS_USER_LED_ACTIVE_LOW=y
```

## configs/boards/xiao_esp32s3/sdkconfig.defaults
```kconfig
CONFIG_PARTITION_TABLE_CUSTOM=y
CONFIG_PARTITION_TABLE_CUSTOM_FILENAME="configs/boards/xiao_esp32s3/partitions.csv"
CONFIG_PARTITION_TABLE_FILENAME="configs/boards/xiao_esp32s3/partitions.csv"

CONFIG_MBEDTLS_X509_TRUSTED_CERT_CALLBACK=y
CONFIG_MBEDTLS_CERTIFICATE_BUNDLE_CROSS_SIGNED_VERIFY=y

CONFIG_ESPTOOLPY_HEADER_FLASHSIZE_UPDATE=y
CONFIG_ESPTOOLPY_FLASHSIZE_8MB=y
CONFIG_ESPTOOLPY_FLASHSIZE="8MB"

CONFIG_ESP_CONSOLE_USB_SERIAL_JTAG=y
CONFIG_ESP_CONSOLE_SECONDARY_NONE=y
CONFIG_ESP_CONSOLE_USB_SERIAL_JTAG_ENABLED=y
CONFIG_ESP_CONSOLE_UART_NUM=-1
CONFIG_ESP_CONSOLE_ROM_SERIAL_PORT_NUM=4

CONFIG_SPIRAM=y
CONFIG_SPIRAM_MODE_OCT=y
CONFIG_SPIRAM_TYPE_AUTO=y
CONFIG_SPIRAM_CLK_IO=30
CONFIG_SPIRAM_CS_IO=26
CONFIG_SPIRAM_SPEED_80M=y
CONFIG_SPIRAM_SPEED=80
CONFIG_SPIRAM_BOOT_HW_INIT=y
CONFIG_SPIRAM_BOOT_INIT=y
CONFIG_SPIRAM_PRE_CONFIGURE_MEMORY_PROTECTION=y
CONFIG_SPIRAM_USE_MALLOC=y
CONFIG_SPIRAM_MEMTEST=y
CONFIG_SPIRAM_MALLOC_ALWAYSINTERNAL=16384
CONFIG_SPIRAM_MALLOC_RESERVE_INTERNAL=32768

CONFIG_ESP_DEFAULT_CPU_FREQ_MHZ_240=y
CONFIG_ESP_DEFAULT_CPU_FREQ_MHZ=240

CONFIG_ESP32QJS_JS_HEAP_SIZE=4194304

CONFIG_ESP32_MQUICKJS_BOARD_NAME="Seeed XIAO ESP32-S3"
CONFIG_ESP32_MQUICKJS_FEATURE_FS=y
CONFIG_ESP32_MQUICKJS_FEATURE_GPIO=y
CONFIG_ESP32_MQUICKJS_FEATURE_LEDC=y
CONFIG_ESP32_MQUICKJS_FEATURE_ADC=y
# ESP32-S3 has no hardware DAC support.
CONFIG_ESP32_MQUICKJS_FEATURE_DAC=n
CONFIG_ESP32_MQUICKJS_FEATURE_I2C=y
CONFIG_ESP32_MQUICKJS_FEATURE_SPI=y
CONFIG_ESP32_MQUICKJS_FEATURE_UART=y
CONFIG_ESP32_MQUICKJS_FEATURE_WIFI=y
CONFIG_ESP32_MQUICKJS_FEATURE_HTTP=y
CONFIG_ESP32_MQUICKJS_FEATURE_HTTP_SERVER=y
CONFIG_ESP32_MQUICKJS_SPI_DEFAULT_SCLK_PIN=7
CONFIG_ESP32_MQUICKJS_SPI_DEFAULT_MOSI_PIN=9
CONFIG_ESP32_MQUICKJS_SPI_DEFAULT_MISO_PIN=8
CONFIG_ESP32_MQUICKJS_SPI_DEFAULT_CS_PIN=-1
CONFIG_ESP32_MQUICKJS_UART_DEFAULT_PORT=1
CONFIG_ESP32_MQUICKJS_UART_DEFAULT_TX_PIN=43
CONFIG_ESP32_MQUICKJS_UART_DEFAULT_RX_PIN=44
```

## main/Kconfig.projbuild
```kconfig
menu "ESP32QJS App"

config ESP32QJS_ENABLE_REPL
    bool "Enable serial JavaScript REPL"
    default y
    help
        Enable the USB Serial/JTAG REPL frontend. Disable this for UI-only
        firmware that should boot index.js without interactive serial editing.

config ESP32QJS_JS_HEAP_SIZE
    int "JavaScript heap size (bytes)"
    range 65536 4194304
    default 163840
    help
        Size of the dedicated heap buffer passed to mquickjs.
        Reduce this on smaller MCUs, or increase it on boards with more RAM.

config ESP32QJS_JS_HEAP_PREFER_PSRAM
    bool "Prefer PSRAM for the JavaScript heap"
    default y
    help
        When enabled, the runtime first tries to allocate the dedicated
        JavaScript heap from PSRAM and falls back to internal RAM.

config ESP32QJS_LITTLEFS_FORMAT_ON_MOUNT_FAIL
    bool "Format LittleFS when mount fails"
    default y
    help
        If enabled, the firmware reformats the storage partition when
        LittleFS mount fails.

endmenu
```

## tests/build-contexts/esp32s3/sdkconfig.defaults
```kconfig
# Firmware-only smoke context. Production feature and memory selection comes from the Hub Build Context.
CONFIG_ESPTOOLPY_HEADER_FLASHSIZE_UPDATE=y
CONFIG_ESPTOOLPY_FLASHSIZE_8MB=y
CONFIG_ESPTOOLPY_FLASHSIZE="8MB"
CONFIG_ESP32_MQUICKJS_PSRAM_MODE="none"
CONFIG_SPIRAM=n
CONFIG_MBEDTLS_INTERNAL_MEM_ALLOC=y
CONFIG_MBEDTLS_EXTERNAL_MEM_ALLOC=n
CONFIG_ESP32QJS_JS_HEAP_SIZE=106496
CONFIG_ESP32_MQUICKJS_WIRELESS_INTERNAL_BUDGET_BYTES=131072
CONFIG_ESP32_MQUICKJS_WIRELESS_PSRAM_BUDGET_BYTES=0
CONFIG_ESP32_MQUICKJS_WIRELESS_CONTROL_RESERVE_BYTES=16384
CONFIG_ESP32_MQUICKJS_FEATURE_FS=y
CONFIG_ESP32QJS_ENABLE_REPL=y
CONFIG_ESP32QJS_AUTORUN_INDEX_JS=y
CONFIG_ESP32QJS_LITTLEFS_FORMAT_ON_MOUNT_FAIL=n

CONFIG_ESP32QJS_SECONDARY_LITTLEFS=y
CONFIG_ESP32QJS_SECONDARY_LITTLEFS_PARTITION_LABEL="workspace"
CONFIG_ESP32QJS_SECONDARY_LITTLEFS_BASE_PATH="/"
```

## tests/js/sdkconfig.defaults
```kconfig
# Exercise native bindings with a compacting collection before every JS allocation.
CONFIG_ESP_TASK_WDT_TIMEOUT_S=30
CONFIG_ESP32QJS_ENABLE_REPL=y
CONFIG_ESP32QJS_LITTLEFS_FORMAT_ON_MOUNT_FAIL=y
CONFIG_ESP32QJS_SECONDARY_LITTLEFS=y
CONFIG_ESP32QJS_SECONDARY_LITTLEFS_PARTITION_LABEL="workspace"
CONFIG_ESP32QJS_SECONDARY_LITTLEFS_BASE_PATH="/workspace"
# CONFIG_ESP32_MQUICKJS_FEATURE_RUNTIME_LOGS is not set
CONFIG_ESP32_MQUICKJS_DEBUG_GC=y
CONFIG_ESP32_MQUICKJS_FEATURE_FS=y
CONFIG_ESP32_MQUICKJS_FEATURE_NVS=y
CONFIG_ESP32_MQUICKJS_FEATURE_GPIO=y
CONFIG_ESP32_MQUICKJS_FEATURE_LEDC=y
CONFIG_ESP32_MQUICKJS_FEATURE_ADC=y
CONFIG_ESP32_MQUICKJS_FEATURE_I2C=y
CONFIG_ESP32_MQUICKJS_FEATURE_SPI=y
CONFIG_ESP32_MQUICKJS_FEATURE_UART=y
CONFIG_ESP32_MQUICKJS_FEATURE_RMT=y
CONFIG_ESP32_MQUICKJS_FEATURE_NET=y
CONFIG_ESP32_MQUICKJS_FEATURE_WIFI=y
CONFIG_ESP32_MQUICKJS_FEATURE_ESPNOW=y
CONFIG_ESP_WIFI_CSI_ENABLED=y
CONFIG_ESP32_MQUICKJS_FEATURE_WIFI_CSI=y
CONFIG_ESP32_MQUICKJS_WIFI_CSI_ALLOW_PROMISCUOUS=y
CONFIG_ESP32_MQUICKJS_FEATURE_RPC=y
CONFIG_BT_ENABLED=y
CONFIG_BT_NIMBLE_ENABLED=y
CONFIG_BT_CONTROLLER_ENABLED=y
CONFIG_BT_BLUEDROID_ENABLED=n
CONFIG_BT_CONTROLLER_ONLY=n
CONFIG_BT_CONTROLLER_DISABLED=n
CONFIG_BT_NIMBLE_MAX_CONNECTIONS=2
CONFIG_BT_NIMBLE_HOST_TASK_STACK_SIZE=6144
CONFIG_ESP32_MQUICKJS_FEATURE_BLE=y
CONFIG_ESP32_MQUICKJS_FEATURE_TLS=y
CONFIG_ESP32_MQUICKJS_FEATURE_SOCKET=y
CONFIG_ESP32_MQUICKJS_FEATURE_HTTP=y
CONFIG_ESP32_MQUICKJS_FEATURE_HTTP_SERVER=y
CONFIG_ESP32_MQUICKJS_FEATURE_WEBSOCKET=y
CONFIG_ESP32_MQUICKJS_FEATURE_BITMAP=y
CONFIG_ESP32_MQUICKJS_SYS_TASK_SNAPSHOT=y
CONFIG_ESP32_MQUICKJS_SYS_TASK_SNAPSHOT_MAX=32
```
