## components/esp32_mquickjs/Kconfig.projbuild
```kconfig
menu "ESP32 mquickjs"

config ESP32_MQUICKJS_MCU_NAME
    string "MCU model name"
    default "ESP32-S3" if IDF_TARGET_ESP32S3
    default "ESP32-C5" if IDF_TARGET_ESP32C5
    default "ESP32-C3" if IDF_TARGET_ESP32C3
    default "ESP32"
    help
        Human-readable MCU model shown by the REPL banner when serial
        interaction is enabled. sys.info.hardware.target reports the ESP-IDF
        target identifier instead.

config ESP32_MQUICKJS_PSRAM_MODE
    string "Compiled PSRAM bus mode"
    default "none"
    help
        Hardware-profile PSRAM mode returned by sys.info.hardware.psram.mode.

menu "Host API features"

config ESP32_MQUICKJS_FEATURE_FS
    bool "Enable fs module"
    default n
    help
        Enable the LittleFS-backed fs module and related script-path settings.

config ESP32_MQUICKJS_FS_READ_TEXT_MAX_BYTES
    int "Maximum fs.readText payload size"
    range 1 1048576
    default 65536
    depends on ESP32_MQUICKJS_FEATURE_FS
    help
        Hard upper bound for one fs.readText() allocation. Callers may request
        a smaller maxBytes limit; larger files must be consumed through a
        binary or text Stream instead of being materialized as one JS string.

config ESP32_MQUICKJS_FEATURE_NVS
    bool "Enable bounded NVS string module"
    default n
    help
        Enable atomic bounded string storage in the default NVS partition.
        This does not enable NVS encryption; production profiles must configure
        their ESP-IDF NVS security provider explicitly.

config ESP32_MQUICKJS_FEATURE_GPIO
    bool "Enable gpio module"
    default n
    help
        Enable GPIO host bindings such as pinMode(), digitalRead(), and
        attachInterrupt().

config ESP32_MQUICKJS_FEATURE_LEDC
    bool "Enable ledc module"
    default n
    depends on SOC_LEDC_SUPPORTED
    help
        Enable LEDC timer/channel bindings for hardware PWM output.

config ESP32_MQUICKJS_FEATURE_ADC
    bool "Enable adc module"
    default n
    depends on SOC_ADC_SUPPORTED
    help
        Enable ADC oneshot and channel-mapping bindings.

config ESP32_MQUICKJS_FEATURE_DAC
    bool "Enable dac module"
    default n
    depends on SOC_DAC_SUPPORTED
    help
        Reserve DAC host-feature selection for targets that expose hardware DAC
        channels.

config ESP32_MQUICKJS_FEATURE_I2C
    bool "Enable i2c module"
    default n
    depends on SOC_I2C_SUPPORTED
    help
        Enable Future-backed I2C controller and persistent device handles,
        exposed through i2c.openBus() and I2CBus.openDevice().

config ESP32_MQUICKJS_FEATURE_SPI
    bool "Enable spi module"
    default n
    depends on SOC_GPSPI_SUPPORTED
    help
        Enable SPI master bus/device bindings such as spi.openBus() and
        SPIDevice.transfer().

config ESP32_MQUICKJS_FEATURE_UART
    bool "Enable uart module"
    default n
    depends on SOC_UART_SUPPORTED
    help
        Enable cooperative Future-backed UART ports, independent RX/TX
        resource lanes, and readiness/error EventQueue watchers.

config ESP32_MQUICKJS_FEATURE_RMT
    bool "Enable rmt module"
    default n
    depends on SOC_RMT_SUPPORTED
    help
        Enable generic bounded RMT receive/transmit channels and native symbol
        buffers. Protocol decoders and board-specific waveform policy remain
        application responsibilities.

config ESP32_MQUICKJS_FEATURE_I2S
    bool "Enable I2S module"
    default n
    depends on SOC_I2S_SUPPORTED
    help
        Enable bounded standard I2S receive, transmit, and duplex bindings,
        plus receive-only hardware PDM-to-PCM.

config ESP32_MQUICKJS_FEATURE_CAMERA
    bool "Enable camera capture module"
    default n
    depends on IDF_TARGET_ESP32S3
    help
        Enable explicit single-frame camera capture backed by esp32-camera.
        Version 1 is an ESP32-S3-only singleton and does not run a video
        encoder or streaming server.

config ESP32_MQUICKJS_FEATURE_NET
    bool "Enable generic network interface module"
    default n
    help
        Enable the transport-neutral net.status() and net.watch() APIs over
        every registered esp-netif interface. Link-specific modules and the
        embedding application remain responsible for creating and controlling
        Wi-Fi, Ethernet, PPP, or custom interfaces.

config ESP32_MQUICKJS_NET_MAX_INTERFACES
    int "Maximum interfaces in one net.status() snapshot"
    range 1 16
    default 8
    depends on ESP32_MQUICKJS_FEATURE_NET
    help
        Bound native storage used while collecting one network-interface
        snapshot. Additional interfaces are omitted and reported through the
        snapshot's truncated flag.

config ESP32_MQUICKJS_FEATURE_WIFI
    bool "Enable wifi module"
    default n
    depends on ESP32_MQUICKJS_FEATURE_NET && SOC_WIFI_SUPPORTED
    select ESP32_MQUICKJS_WIFI_RADIO
    help
        Enable Wi-Fi station bindings such as wifi.status(), wifi.scan(), and
        wifi.connect().

config ESP32_MQUICKJS_WIFI_RADIO
    bool
    depends on SOC_WIFI_SUPPORTED
    help
        Internal boot-scoped Wi-Fi radio service shared by the public Wi-Fi
        module and connectionless wireless transports such as ESP-NOW.

config ESP32_MQUICKJS_FEATURE_ESPNOW
    bool "Enable ESP-NOW module"
    default n
    depends on SOC_WIFI_SUPPORTED
    select ESP32_MQUICKJS_WIFI_RADIO
    select ESP_WIFI_STA_DISCONNECTED_PM_ENABLE
    help
        Enable bounded station-interface ESP-NOW sessions with a fixed receive
        pool, EventQueue delivery, peer management, and Future-backed sends.

config ESP32_MQUICKJS_FEATURE_WIFI_CSI
    bool "Enable Wi-Fi CSI module"
    default n
    depends on SOC_WIFI_SUPPORTED && ESP_WIFI_CSI_ENABLED
    depends on IDF_TARGET_ESP32C3 || IDF_TARGET_ESP32C5 || IDF_TARGET_ESP32S3
    select ESP32_MQUICKJS_WIFI_RADIO
    help
        Enable bounded raw Wi-Fi channel-state capture. The callback copies
        normalized metadata and driver CSI bytes into a fixed internal-memory
        pool; DSP and application policy remain in JavaScript.

config ESP32_MQUICKJS_WIFI_CSI_POOL_CAPACITY
    int "Wi-Fi CSI frame pool capacity"
    range 2 128
    default 16
    depends on ESP32_MQUICKJS_FEATURE_WIFI_CSI

config ESP32_MQUICKJS_WIFI_CSI_QUEUE_LEN
    int "Wi-Fi CSI receive queue capacity"
    range 1 128
    default 16
    depends on ESP32_MQUICKJS_FEATURE_WIFI_CSI
    help
        Must not exceed the frame pool capacity. Invalid Build Contexts fail
        at compile time and runtime initialization.

config ESP32_MQUICKJS_WIFI_CSI_MAX_FRAME_BYTES
    int "Maximum bytes retained per Wi-Fi CSI frame"
    range 128 4096
    default 1024 if IDF_TARGET_ESP32C5
    default 512
    depends on ESP32_MQUICKJS_FEATURE_WIFI_CSI

config ESP32_MQUICKJS_WIFI_CSI_MAX_BATCH_FRAMES
    int "Maximum frames in one Wi-Fi CSI batch"
    range 1 128
    default 8
    depends on ESP32_MQUICKJS_FEATURE_WIFI_CSI

config ESP32_MQUICKJS_WIFI_CSI_ALLOW_PROMISCUOUS
    bool "Allow explicit promiscuous Wi-Fi CSI sessions"
    default n
    depends on ESP32_MQUICKJS_FEATURE_WIFI_CSI

config ESP32_MQUICKJS_WIFI_CSI_ALLOW_FIXED_CHANNEL
    bool "Allow explicit fixed-channel Wi-Fi CSI sessions"
    default n
    depends on ESP32_MQUICKJS_FEATURE_WIFI_CSI

config ESP32_MQUICKJS_ESPNOW_RX_QUEUE_LEN
    int "Default ESP-NOW receive capacity"
    range 1 32
    default 8
    depends on ESP32_MQUICKJS_FEATURE_ESPNOW

config ESP32_MQUICKJS_ESPNOW_RX_MAX_QUEUE_LEN
    int "Maximum ESP-NOW receive capacity"
    range 1 64
    default 16
    depends on ESP32_MQUICKJS_FEATURE_ESPNOW

config ESP32_MQUICKJS_ESPNOW_DEFAULT_MAX_PAYLOAD_BYTES
    int "Default ESP-NOW payload limit"
    range 1 1470
    default 250
    depends on ESP32_MQUICKJS_FEATURE_ESPNOW

config ESP32_MQUICKJS_ESPNOW_MAX_PAYLOAD_BYTES
    int "Maximum ESP-NOW payload limit"
    range 1 1470
    default 250
    depends on ESP32_MQUICKJS_FEATURE_ESPNOW

config ESP32_MQUICKJS_ESPNOW_ALLOW_V2_PAYLOAD
    bool "Allow ESP-NOW v2 payloads"
    default n
    depends on ESP32_MQUICKJS_FEATURE_ESPNOW

config ESP32_MQUICKJS_ESPNOW_DEFAULT_SEND_TIMEOUT_MS
    int "Default ESP-NOW send timeout (ms)"
    range 1 60000
    default 1000
    depends on ESP32_MQUICKJS_FEATURE_ESPNOW

config ESP32_MQUICKJS_ESPNOW_MAX_PEERS
    int "Maximum application ESP-NOW peers"
    range 1 19
    default 19
    depends on ESP32_MQUICKJS_FEATURE_ESPNOW
    help
        One additional ESP-IDF peer slot is reserved for broadcast.

config ESP32_MQUICKJS_FEATURE_BLE
    bool "Enable Bluetooth LE module"
    default n
    depends on SOC_BLE_SUPPORTED && BT_NIMBLE_ENABLED && BT_CONTROLLER_ENABLED
    select BT_NIMBLE_ROLE_CENTRAL
    select BT_NIMBLE_ROLE_PERIPHERAL
    select BT_NIMBLE_ROLE_OBSERVER
    select BT_NIMBLE_ROLE_BROADCASTER
    select BT_NIMBLE_GATT_CLIENT
    select BT_NIMBLE_GATT_SERVER
    select BT_NIMBLE_SECURITY_ENABLE
    select BT_NIMBLE_NVS_PERSIST
    help
        Enable bounded BLE central, peripheral, observer, broadcaster, GATT,
        security, and native-cached GATT Server bindings over ESP-NimBLE.

config ESP32_MQUICKJS_WIRELESS_COEX
    bool
    default y if ESP32_MQUICKJS_FEATURE_BLE && ESP32_MQUICKJS_WIFI_RADIO
    select ESP_COEX_SW_COEXIST_ENABLE
    help
        Internal software-coexistence selection for builds combining BLE with
        Wi-Fi or ESP-NOW. BLE-only builds do not select coexistence.

config ESP32_MQUICKJS_BLE_MAX_CONNECTIONS
    int "Maximum BLE connections exposed to JavaScript"
    range 1 8
    default 2
    depends on ESP32_MQUICKJS_FEATURE_BLE

config ESP32_MQUICKJS_BLE_SCAN_QUEUE_LEN
    int "Default BLE scan report capacity"
    range 1 64
    default 16
    depends on ESP32_MQUICKJS_FEATURE_BLE

config ESP32_MQUICKJS_BLE_SCAN_QUEUE_MAX_LEN
    int "Maximum BLE scan report capacity"
    range 1 64
    default 32
    depends on ESP32_MQUICKJS_FEATURE_BLE

config ESP32_MQUICKJS_BLE_CONNECTION_QUEUE_LEN
    int "BLE connection control event capacity"
    range 2 32
    default 8
    depends on ESP32_MQUICKJS_FEATURE_BLE

config ESP32_MQUICKJS_BLE_NOTIFICATION_QUEUE_LEN
    int "Default BLE notification capacity"
    range 1 32
    default 8
    depends on ESP32_MQUICKJS_FEATURE_BLE

config ESP32_MQUICKJS_BLE_SERVER_QUEUE_LEN
    int "Default BLE GATT Server event capacity"
    range 1 32
    default 8
    depends on ESP32_MQUICKJS_FEATURE_BLE

config ESP32_MQUICKJS_BLE_MAX_SERVICES
    int "Maximum application GATT services"
    range 1 32
    default 16
    depends on ESP32_MQUICKJS_FEATURE_BLE

config ESP32_MQUICKJS_BLE_MAX_CHARACTERISTICS
    int "Maximum application GATT characteristics"
    range 1 64
    default 32
    depends on ESP32_MQUICKJS_FEATURE_BLE

config ESP32_MQUICKJS_BLE_MAX_DESCRIPTORS
    int "Maximum discovered GATT descriptors"
    range 1 128
    default 32
    depends on ESP32_MQUICKJS_FEATURE_BLE

config ESP32_MQUICKJS_BLE_MAX_ATTRIBUTE_BYTES
    int "Maximum bytes in one BLE attribute value"
    range 20 512
    default 512
    depends on ESP32_MQUICKJS_FEATURE_BLE

config ESP32_MQUICKJS_BLE_BONDING
    bool "Enable persistent BLE bonding"
    default y
    depends on ESP32_MQUICKJS_FEATURE_BLE

config ESP32_MQUICKJS_BLE_HOST_TASK_STACK_SIZE
    int "NimBLE Host task stack size"
    range 4096 16384
    default 6144
    depends on ESP32_MQUICKJS_FEATURE_BLE

config ESP32_MQUICKJS_FEATURE_TLS
    bool "Enable public-CA TLS transport capability"
    default n
    depends on ESP32_MQUICKJS_FEATURE_NET
    select MBEDTLS_CERTIFICATE_BUNDLE
    select MBEDTLS_HAVE_TIME_DATE
    select MBEDTLS_SSL_KEEP_PEER_CERTIFICATE
    select ESP_HTTP_CLIENT_ENABLE_HTTPS if ESP32_MQUICKJS_FEATURE_HTTP
    help
        Enable the shared TLS capability used by HTTPS and secure TCP sockets.
        Public CA, hostname, and certificate-date verification remain
        mandatory. When disabled, HTTP and socket modules remain available for
        plaintext transports without linking the CA bundle or TLS paths.

config ESP32_MQUICKJS_FEATURE_SOCKET
    bool "Enable socket module"
    default n
    depends on ESP32_MQUICKJS_FEATURE_NET
    help
        Enable generic handle-based socket APIs for TCP streams/listeners and
        UDP datagrams. Outbound TCP handles may use TLS only when the separate
        TLS capability is enabled. Framing, reconnect policy, authentication,
        and all application protocols remain application responsibilities.

config ESP32_MQUICKJS_FEATURE_RPC
    bool "Enable generic native binary RPC codec"
    default n
    help
        Enable the optional esp32qjs.rpc/1 COBS, CRC-32, deterministic CBOR,
        segmentation, reassembly, and transparent ByteSpanSource bridge.
        Applications supply their own field table, dynamic-value fields,
        stream spool directory, opcodes, authentication, dispatch, queueing,
        and business validation. The framework contains no Agent contract.

config ESP32_MQUICKJS_FEATURE_HTTP
    bool "Enable http module"
    default n
    depends on ESP32_MQUICKJS_FEATURE_NET
    help
        Enable fetch(), http.fetch(), and related HTTP client helpers over any
        active esp-netif transport.

config ESP32_MQUICKJS_FEATURE_HTTP_SERVER
    bool "Enable http_server feature"
    default n
    depends on ESP32_MQUICKJS_FEATURE_NET
    help
        Enable the declarative http.server() route/request EventQueue API.

config ESP32_MQUICKJS_FEATURE_USB_SERIAL
    bool "Enable USB Serial/JTAG message transport"
    default n
    depends on SOC_USB_SERIAL_JTAG_SUPPORTED && !ESP32QJS_ENABLE_REPL
    help
        Enable the bounded usbSerial EventQueue/send API for headless JSON-line
        protocols. The REPL and this transport are mutually exclusive because
        they consume the same USB Serial/JTAG input stream.

config ESP32_MQUICKJS_FEATURE_WEBSOCKET
    bool "Enable WebSocket client module"
    default n
    depends on ESP32_MQUICKJS_FEATURE_NET && ESP32_MQUICKJS_FEATURE_TLS
    help
        Enable the outbound websocketClient callback/send API. Applications
        connect only after a network interface is ready and remain responsible
        for pairing and authorization policy. The current ESP-IDF WebSocket
        component contains WS and WSS in one transport library, so selecting
        this module also requires the TLS capability.

config ESP32_MQUICKJS_FEATURE_BITMAP
    bool "Enable bitmap module"
    default n
    help
        Enable the native bitmap module for C-backed mono1, gray8, rgb565,
        and rgb888 buffers, worker-backed crop/rotate/resize/color transforms,
        drawing primitives, dirty bounds, and byte-view/span exports.

config ESP32_MQUICKJS_FEATURE_RUNTIME_LOGS
    bool "Capture Agent standard output for host diagnostics"
    default n
    help
        Capture JavaScript print output, uncaught exceptions, runtime
        diagnostics, and ESP-IDF component output in a bounded native ring.
        The ring records raw text and its origin, not log levels; the Agent
        protocol forwards those chunks without classifying them.
        The internal runtimeLogs.read() bridge exists only for the headless
        Agent profile; this does not add a JavaScript logger, configurable log
        levels, filtering, or persistence. Captured output is not mirrored to
        the protocol serial transport.

endmenu

config ESP32_MQUICKJS_SYS_TASK_SNAPSHOT
    bool "Enable bounded sys.tasks() FreeRTOS snapshots"
    default n
    select FREERTOS_USE_TRACE_FACILITY
    help
        Enable explicit, bounded task metadata snapshots through sys.tasks().
        This exposes no task handles or mutation operations and does not enable
        formatted or run-time CPU statistics.

config ESP32_MQUICKJS_SYS_TASK_SNAPSHOT_MAX
    int "Maximum tasks in one sys.tasks() native snapshot"
    range 1 64
    default 32
    depends on ESP32_MQUICKJS_SYS_TASK_SNAPSHOT
    help
        Bound the temporary native TaskStatus_t allocation used by sys.tasks().

config ESP32_MQUICKJS_DEBUG_GC
    bool "Force garbage collection before every allocation"
    default n
    help
        Enable MicroQuickJS DEBUG_GC mode so every allocation first compacts
        the JavaScript heap. This is intentionally slow and should only be
        enabled in automated tests or while auditing native bindings for
        missing JSGCRef roots.

config ESP32_MQUICKJS_DEFAULT_EVAL_TIMEOUT_MS
    int "Default JavaScript eval timeout (ms)"
    range 50 60000
    default 250
    help
        Default timeout for direct JavaScript evaluation and native-to-JavaScript
        callbacks. Scoped deadlines may shorten but never extend this budget.

config ESP32_MQUICKJS_COOPERATIVE_WAIT_SLICE_MS
    int "Maximum native wait slice (ms)"
    range 10 1000
    default 250
    help
        Split sleep, event waits, and driver queue waits into bounded slices so
        the runtime can feed its task watchdog and observe stop requests.

config ESP32_MQUICKJS_MAX_TIMERS
    int "Maximum active JS timers"
    range 1 64
    default 16
    help
        Maximum number of active setTimeout/setInterval handles.

config ESP32_MQUICKJS_MIN_INTERVAL_MS
    int "Minimum setInterval period (ms)"
    range 1 1000
    default 10
    help
        Clamp shorter setInterval periods to this value so a callback cannot
        monopolize the runtime with a zero-delay repeating timer.

config ESP32_MQUICKJS_TIMER_QUEUE_LEN
    int "Timer event queue length"
    range 1 64
    default 16
    help
        Queue depth used to deliver timer callbacks back to the REPL thread.

config ESP32_MQUICKJS_MAX_FUTURES
    int "Maximum active Futures"
    range 2 32
    default 8
    help
        Bounded number of queued or pending Future operations. Completed
        results move to their JavaScript handles and no longer occupy an I/O
        scheduler slot.

config ESP32_MQUICKJS_INTERNAL_FUTURE_RESERVE
    int "Reserved internal Future slots"
    range 2 8
    default 4
    help
        Additional scheduler slots reserved for synchronous native adapters
        such as EventQueue, socket, filesystem, and transport operations.
        JavaScript Future calls cannot consume this reserve, so protocol and
        cancellation paths remain responsive when public capacity is full.

config ESP32_MQUICKJS_FUTURE_READY_QUEUE_LEN
    int "Future ready queue length"
    range 2 64
    default 16
    help
        Wake-token queue depth shared by native Future drivers and timers.

config ESP32_MQUICKJS_FUTURE_DISPATCH_BATCH
    int "Future submission dispatch batch"
    range 1 32
    default 8
    help
        Maximum FIFO submissions started at one scheduler safe point.

config ESP32_MQUICKJS_FUTURE_READY_BATCH
    int "Future ready polling batch"
    range 1 32
    default 16
    help
        Maximum wake tokens polled at one scheduler safe point.

config ESP32_MQUICKJS_FUTURE_WORKER_POOL_SIZE
    int "Blocking I/O Future worker count"
    range 1 4
    default 2
    help
        Fixed FreeRTOS worker count shared by Future drivers for blocking
        native operations such as I2C and flash storage.

config ESP32_MQUICKJS_FUTURE_WORKER_QUEUE_LEN
    int "Blocking I/O Future worker queue length"
    range 2 32
    default 8
    help
        Bounded number of prepared native operations waiting for a generic
        Future worker. Submissions fail with BUSY when this queue is full.

config ESP32_MQUICKJS_FUTURE_RESOURCE_LANE_QUEUE_LEN
    int "Per-resource Future waiting queue length"
    range 1 32
    default 8
    help
        Maximum number of captured native operations that may wait behind an
        active operation with the same resource key. Equal keys execute in
        strict FIFO order without occupying a blocking I/O worker while queued.

config ESP32_MQUICKJS_MAX_SCRIPT_PATH
    int "Maximum script path length"
    range 128 1024
    default 256
    depends on ESP32_MQUICKJS_FEATURE_FS
    help
        Maximum LittleFS path length accepted by load() and fs APIs.

config ESP32_MQUICKJS_USER_LED_PIN
    int "User LED GPIO"
    range -1 48
    default -1
    depends on ESP32_MQUICKJS_FEATURE_GPIO
    help
        GPIO used for gpio.led() and gpio.LED_BUILTIN.

config ESP32_MQUICKJS_USER_LED_ACTIVE_LOW
    bool "User LED is active-low"
    default y
    depends on ESP32_MQUICKJS_FEATURE_GPIO
    help
        Enable this for boards where writing low turns the LED on.

config ESP32_MQUICKJS_I2C_DEFAULT_SDA_PIN
    int "Default I2C SDA GPIO"
    range -1 48
    default -1
    depends on ESP32_MQUICKJS_FEATURE_I2C
    help
        Default SDA pin used by i2c.openBus() when no pin override is provided.

config ESP32_MQUICKJS_I2C_DEFAULT_SCL_PIN
    int "Default I2C SCL GPIO"
    range -1 48
    default -1
    depends on ESP32_MQUICKJS_FEATURE_I2C
    help
        Default SCL pin used by i2c.openBus() when no pin override is provided.

config ESP32_MQUICKJS_I2C_DEFAULT_FREQ_HZ
    int "Default I2C clock frequency (Hz)"
    range 10000 1000000
    default 400000
    depends on ESP32_MQUICKJS_FEATURE_I2C
    help
        Default I2C bus speed used by i2c.openBus().

config ESP32_MQUICKJS_I2C_DEFAULT_TIMEOUT_MS
    int "Default I2C transfer timeout (ms)"
    range 1 5000
    default 100
    depends on ESP32_MQUICKJS_FEATURE_I2C
    help
        Default timeout inherited by I2CBus.scan() and devices created by
        I2CBus.openDevice().

config ESP32_MQUICKJS_I2C_ENABLE_INTERNAL_PULLUP
    bool "Enable internal pull-up for I2C"
    default y
    depends on ESP32_MQUICKJS_FEATURE_I2C
    help
        Enable the internal SDA/SCL pull-up resistors when opening the I2C bus.

config ESP32_MQUICKJS_SPI_DEFAULT_SCLK_PIN
    int "Default SPI SCLK GPIO"
    range -1 48
    default -1
    depends on ESP32_MQUICKJS_FEATURE_SPI
    help
        Default SCLK pin used by spi.openBus() when no pin override is provided.

config ESP32_MQUICKJS_SPI_DEFAULT_MOSI_PIN
    int "Default SPI MOSI GPIO"
    range -1 48
    default -1
    depends on ESP32_MQUICKJS_FEATURE_SPI
    help
        Default MOSI pin used by spi.openBus() when no pin override is provided.
        Use -1 for read-only buses without a MOSI signal.

config ESP32_MQUICKJS_SPI_DEFAULT_MISO_PIN
    int "Default SPI MISO GPIO"
    range -1 48
    default -1
    depends on ESP32_MQUICKJS_FEATURE_SPI
    help
        Default MISO pin used by spi.openBus() when no pin override is provided.
        Use -1 for write-only buses without a MISO signal.

config ESP32_MQUICKJS_SPI_DEFAULT_CS_PIN
    int "Default SPI CS GPIO"
    range -1 48
    default -1
    depends on ESP32_MQUICKJS_FEATURE_SPI
    help
        Default chip-select pin used by SPIBus.openDevice() when no pin override
        is provided. Use -1 when chip-select is device-specific or managed
        manually.

config ESP32_MQUICKJS_SPI_DEFAULT_FREQ_HZ
    int "Default SPI device clock frequency (Hz)"
    range 10000 40000000
    default 1000000
    depends on ESP32_MQUICKJS_FEATURE_SPI
    help
        Default device clock used by SPIBus.openDevice().

config ESP32_MQUICKJS_SPI_DEFAULT_QUEUE_SIZE
    int "Default SPI device queue size"
    range 1 16
    default 1
    depends on ESP32_MQUICKJS_FEATURE_SPI
    help
        Default queue depth used by SPIBus.openDevice().

config ESP32_MQUICKJS_SPI_DEFAULT_MAX_TRANSFER_SIZE
    int "Default SPI bus max transfer size (bytes)"
    range 1 65536
    default 4092
    depends on ESP32_MQUICKJS_FEATURE_SPI
    help
        Default max transfer size used by spi.openBus().

config ESP32_MQUICKJS_SPI_MAX_DEVICES_PER_BUS
    int "Maximum SPI devices per bus"
    range 1 8
    default 4
    depends on ESP32_MQUICKJS_FEATURE_SPI
    help
        Maximum concurrently opened SPIDevice handles tracked per SPI bus.

config ESP32_MQUICKJS_UART_DEFAULT_PORT
    int "Default UART port"
    range 0 2
    default 1
    depends on ESP32_MQUICKJS_FEATURE_UART
    help
        Default UART peripheral number used by uart.open().

config ESP32_MQUICKJS_UART_DEFAULT_TX_PIN
    int "Default UART TX GPIO"
    range -1 48
    default -1
    depends on ESP32_MQUICKJS_FEATURE_UART
    help
        Default TX pin used by uart.open(). Use -1 when TX must be supplied
        explicitly.

config ESP32_MQUICKJS_UART_DEFAULT_RX_PIN
    int "Default UART RX GPIO"
    range -1 48
    default -1
    depends on ESP32_MQUICKJS_FEATURE_UART
    help
        Default RX pin used by uart.open(). Use -1 when RX must be supplied
        explicitly.

config ESP32_MQUICKJS_UART_DEFAULT_BAUD
    int "Default UART baud rate"
    range 300 5000000
    default 115200
    depends on ESP32_MQUICKJS_FEATURE_UART
    help
        Default baud rate used by uart.open().

config ESP32_MQUICKJS_UART_DEFAULT_RX_BUFFER_SIZE
    int "Default UART RX buffer size"
    range 129 16384
    default 1024
    depends on ESP32_MQUICKJS_FEATURE_UART
    help
        Default UART driver RX buffer size in bytes.

config ESP32_MQUICKJS_UART_DEFAULT_TX_BUFFER_SIZE
    int "Default UART TX buffer size"
    range 0 16384
    default 1024
    depends on ESP32_MQUICKJS_FEATURE_UART
    help
        Default UART driver TX buffer size in bytes. Zero disables the driver
        TX ring buffer and writes directly through the hardware FIFO.

config ESP32_MQUICKJS_UART_DEFAULT_TIMEOUT_MS
    int "Default UART I/O timeout (ms)"
    range 0 5000
    default 100
    depends on ESP32_MQUICKJS_FEATURE_UART
    help
        Default timeout used by UARTPort read, write, and flush operations.

config ESP32_MQUICKJS_WIFI_DEFAULT_TIMEOUT_MS
    int "Default Wi-Fi connect timeout (ms)"
    range 1000 120000
    default 15000
    depends on ESP32_MQUICKJS_FEATURE_WIFI
    help
        Default timeout used by wifi.connect().

config ESP32_MQUICKJS_HTTP_DEFAULT_TIMEOUT_MS
    int "Default HTTP request timeout (ms)"
    range 1000 120000
    default 15000
    depends on ESP32_MQUICKJS_FEATURE_HTTP
    help
        Default timeout used by fetch() and http.fetch().

config ESP32_MQUICKJS_HTTP_MAX_RESPONSE_BODY_BYTES
    int "Default maximum HTTP response body size (bytes)"
    range 1024 4194304
    default 65536
    depends on ESP32_MQUICKJS_FEATURE_HTTP
    help
        Stop fetch response capture after this many bytes. Individual requests
        can select a smaller or larger positive limit with maxBodyBytes.

config ESP32_MQUICKJS_HTTP_MAX_REQUEST_BODY_BYTES
    int "Maximum materialized HTTP request body size (bytes)"
    range 1024 4194304
    default 1048576
    depends on ESP32_MQUICKJS_FEATURE_HTTP
    help
        Bound request bodies before the HTTP worker starts. Stream, ByteView,
        and ByteSpanSource bodies are materialized into a native buffer so the
        worker never accesses JavaScript-owned memory.

config ESP32_MQUICKJS_HTTP_TASK_STACK_SIZE
    int "HTTP async worker task stack size (bytes)"
    range 4096 32768
    default 8192
    depends on ESP32_MQUICKJS_FEATURE_HTTP
    help
        Stack size used by the async HTTP worker task.

config ESP32_MQUICKJS_HTTP_TASK_STACK_IN_PSRAM
    bool "Prefer PSRAM for HTTP async worker task stacks"
    default y
    depends on ESP32_MQUICKJS_FEATURE_HTTP
    depends on SPIRAM
    depends on FREERTOS_TASK_CREATE_ALLOW_EXT_MEM
    help
        Allocate each HTTP worker task stack from PSRAM when possible. This
        preserves scarce internal RAM for Wi-Fi, TLS, and native driver state.
        If PSRAM allocation fails at runtime, the worker falls back to the
        normal internal-RAM task allocator.

config ESP32_MQUICKJS_USB_SERIAL_MAX_FRAME_BYTES
    int "Maximum USB serial frame or binary chunk size (bytes)"
    range 256 16384
    default 8192
    depends on ESP32_MQUICKJS_FEATURE_USB_SERIAL
    help
        Maximum complete text frame or binary chunk accepted or sent by
        usbSerial. Text overflow is discarded through the next line boundary;
        binary overflow is reported as an EventQueue error.

config ESP32_MQUICKJS_USB_SERIAL_RX_BUFFER_SIZE
    int "USB serial driver RX buffer size (bytes)"
    range 256 16384
    default 2048
    depends on ESP32_MQUICKJS_FEATURE_USB_SERIAL

config ESP32_MQUICKJS_USB_SERIAL_TX_BUFFER_SIZE
    int "USB serial driver TX buffer size (bytes)"
    range 256 16384
    default 2048
    depends on ESP32_MQUICKJS_FEATURE_USB_SERIAL

config ESP32_MQUICKJS_SOCKET_MAX_HANDLES
    int "Maximum simultaneous socket handles"
    range 1 16
    default 8
    depends on ESP32_MQUICKJS_FEATURE_SOCKET

config ESP32_MQUICKJS_SOCKET_MAX_MESSAGE_BYTES
    int "Maximum socket send/receive chunk size (bytes)"
    range 256 32768
    default 8192
    depends on ESP32_MQUICKJS_FEATURE_SOCKET

config ESP32_MQUICKJS_SOCKET_MAX_SOURCE_BYTES
    int "Maximum streamed TCP source size (bytes)"
    range 32768 67108864
    default 1048576
    depends on ESP32_MQUICKJS_FEATURE_SOCKET
    help
        Bound a ByteSpanSource consumed by TCPSocket.send(). Individual spans
        are written directly and remain limited only by the source contract.

config ESP32_MQUICKJS_WEBSOCKET_MAX_MESSAGE_BYTES
    int "Maximum WebSocket text message size (bytes)"
    range 256 32768
    default 8192
    depends on ESP32_MQUICKJS_FEATURE_WEBSOCKET
    help
        Maximum reassembled inbound text message and outbound send size.

config ESP32_MQUICKJS_WEBSOCKET_EVENT_QUEUE_LEN
    int "WebSocket event queue length"
    range 2 32
    default 8
    depends on ESP32_MQUICKJS_FEATURE_WEBSOCKET

config ESP32_MQUICKJS_WEBSOCKET_TASK_STACK_SIZE
    int "WebSocket client task stack size (bytes)"
    range 4096 32768
    default 6144
    depends on ESP32_MQUICKJS_FEATURE_WEBSOCKET

endmenu
```
