
int main(void) {
    esp_wps_config_t config={.wps_type=WPS_TYPE_PIN};uint64_t id=0;
    esp32_mquickjs_wifi_wps_native_status_t status;
    esp32_mquickjs_wifi_wps_credentials_t credentials;
    uint8_t pin[8];
    on_native=false;assert(esp32qjs_wps_native_begin(&config,&id)==ESP_ERR_INVALID_STATE && !id);
    on_native=true;foreign_owner=true;
    assert(esp32qjs_wps_native_begin(&config,&id)==ESP_ERR_INVALID_STATE && !allocations);
    foreign_owner=false;dpp_enabled=true;
    assert(esp32qjs_wps_native_begin(&config,&id)==ESP_ERR_INVALID_STATE && !allocations);
    dpp_enabled=false;success_pending=true;
    assert(esp32qjs_wps_native_begin(&config,&id)==ESP_ERR_INVALID_STATE && !allocations);
    success_pending=false;fail_alloc=true;
    assert(esp32qjs_wps_native_begin(&config,&id)==ESP_ERR_NO_MEM && !id);
    fail_alloc=false;s_wps_native_last_identity=UINT64_C(0x123400000005);
    assert(esp32qjs_wps_native_begin(&config,&id)==ESP_OK && id==UINT64_C(0x123400000006));
    assert(esp32qjs_wps_native_held() && allocations==1);
    assert(esp32qjs_wps_native_pin_copy(id,pin)==ESP_OK && !memcmp(pin,"12345670",8));
    assert(esp32qjs_wps_native_pin_copy(id,pin)==ESP_OK); /* Copy is not consumption. */
    assert(esp32qjs_wps_native_pin_commit(id+1)==ESP_ERR_INVALID_STATE);
    assert(esp32qjs_wps_native_pin_commit(id)==ESP_OK);
    for(unsigned i=0;i<8;i++)assert(!s_wps_native->pin[i]);
    assert(esp32qjs_wps_native_pin_copy(id,pin)==ESP_ERR_INVALID_STATE);
    assert(esp32qjs_wps_unmanaged_disable(NULL,NULL)==ESP_ERR_INVALID_STATE && !type_calls);
    assert(esp32qjs_wps_native_start(id)==ESP_OK && start_calls==1);
    assert(esp32qjs_wps_native_start(id)==ESP_ERR_INVALID_STATE && start_calls==1);
    assert((uintptr_t)timer_high==0x1234 && (uintptr_t)timer_low==6);
    sample.wps=&sample;sample.state=WAIT_START;native_wps_status=WPS_STATUS_PENDING;
    memset(sample.bssid,0x22,6);memcpy(associated_bssid,sample.bssid,6);
    uint8_t foreign_bssid[6]={1,2,3,4,5,6};
    assert(esp32qjs_wps_rx_peer(&sample,sample.bssid));
    assert(!esp32qjs_wps_rx_peer(&sample,foreign_bssid));
    associated_error=55;assert(!esp32qjs_wps_rx_peer(&sample,sample.bssid));associated_error=0;
    associated_bssid[5]++;assert(!esp32qjs_wps_rx_peer(&sample,sample.bssid));associated_bssid[5]--;
    sample.state=99;assert(!esp32qjs_wps_rx_peer(&sample,sample.bssid));sample.state=WAIT_START;
    native_wps_status=WPS_STATUS_DISABLE;assert(!esp32qjs_wps_rx_peer(&sample,sample.bssid));
    assert(esp32qjs_wps_timer_exact(timer_high,timer_low));
    timer_handler(timer_high,(void *)(uintptr_t)5);
    assert(!s_wps_native->status.terminal_seen && !disable_calls);
    sample.ap_cred_cnt=3;
    for(unsigned i=0;i<3;i++) {
        sample.creds[i].ssid_len=32;sample.creds[i].key_len=64;
        memset(sample.creds[i].ssid,0x40+i,32);memset(sample.creds[i].key,0x60+i,64);
        sample.creds[i].auth_type=0x20;sample.creds[i].encr_type=8;
    }
    disconnect_error=201;
    assert(esp32qjs_wps_native_finish(&sample)==201 && !disable_calls);
    assert(esp32qjs_wps_native_credentials_copy(id,&credentials)==ESP_ERR_INVALID_STATE);
    assert(esp32qjs_wps_native_status(id,&status)==ESP_OK && status.terminal_seen && status.cleanup_error==201);
    assert(!esp32qjs_wps_timer_exact(timer_high,timer_low));
    disconnect_error=0;type_error=202;
    assert(esp32qjs_wps_native_stop_sdk()==202 && disconnect_calls==2 && !disable_calls);
    type_error=0;disable_error=203;
    assert(esp32qjs_wps_native_stop_sdk()==203 && disconnect_calls==2 && type_calls==2 && disable_calls==1);
    disable_error=0;
    assert(esp32qjs_wps_native_stop_sdk()==ESP_OK && disconnect_calls==2 && type_calls==2 && disable_calls==2);
    assert(esp32qjs_wps_native_credentials_copy(id,&credentials)==ESP_OK && credentials.count==3);
    assert(credentials.entries[2].ssid_length==32 && credentials.entries[2].password_length==64);
    assert(!memcmp(credentials.entries[2].password,sample.creds[2].key,64));
    assert(esp32qjs_wps_native_credentials_copy(id,&credentials)==ESP_OK);
    assert(esp32qjs_wps_native_credentials_commit(id+1)==ESP_ERR_INVALID_STATE);
    assert(esp32qjs_wps_native_credentials_commit(id)==ESP_OK);
    for(size_t i=0;i<sizeof(s_wps_native->credentials);i++)assert(!((u8 *)&s_wps_native->credentials)[i]);
    assert(esp32qjs_wps_native_close(id+1)==ESP_ERR_INVALID_STATE);
    assert(esp32qjs_wps_native_close(id)==ESP_OK && disable_calls==2 && !posts);
    assert(esp32qjs_wps_native_close(id)==ESP_OK && disable_calls==2);
    uint64_t next=0;assert(esp32qjs_wps_native_begin(&config,&next)==ESP_ERR_INVALID_STATE && !next);
    fixture_dispose();
    assert(esp32qjs_wps_native_begin(&config,&next)==ESP_OK && next>id);
    assert(esp32qjs_wps_native_close(id)==ESP_ERR_INVALID_STATE);
    assert(esp32qjs_wps_native_pin_copy(next,pin)==ESP_OK);
    assert(esp32qjs_wps_native_start(next)==ESP_OK);
    timer_handler(timer_high,timer_low);
    assert(esp32qjs_wps_native_status(next,&status)==ESP_OK && status.error==ESP_ERR_TIMEOUT);
    assert(status.terminal_seen && status.inputs_stopped && !status.pin_available && !posts);
    assert(status.callback_depth==0 && !status.sdk_state_retired && gWpsSm);
    assert(esp32qjs_wps_callback_enter());
    assert(esp32qjs_wps_native_retire_state(next)==ESP_ERR_INVALID_STATE && !deinit_calls);
    esp32qjs_wps_callback_leave();
    deinit_error=401;
    assert(esp32qjs_wps_native_retire_state(next)==401 && gWpsSm);
    deinit_error=0;
    assert(esp32qjs_wps_native_retire_state(next)==ESP_OK && !gWpsSm && deinit_calls==2);
    assert(esp32qjs_wps_native_retire_state(next)==ESP_OK && deinit_calls==2);
    assert(esp32qjs_wps_native_held()); /* SDK state retirement does not release result. */
    assert(!esp32qjs_wps_timer_exact(timer_high,timer_low));
    fixture_dispose();next=0;timer_error=-1;
    assert(esp32qjs_wps_native_begin(&config,&next)==ESP_OK);
    assert(esp32qjs_wps_native_start(next)==-1);
    assert(esp32qjs_wps_native_status(next,&status)==ESP_OK && status.terminal_seen && status.error==-1);
    assert(status.error_stage==ESP32QJS_WPS_STAGE_TIMER);
    assert(esp32qjs_wps_record_error(999,ESP32QJS_WPS_STAGE_CONNECT)==999);
    assert(s_wps_native->status.error==-1 && s_wps_native->status.error_stage==ESP32QJS_WPS_STAGE_TIMER);
    assert(esp32qjs_wps_native_close(next)==ESP_OK && !posts);
    fixture_dispose();next=0;enable_error=204;
    assert(esp32qjs_wps_native_begin(&config,&next)==204 && next);
    assert(esp32qjs_wps_native_held() && esp32qjs_wps_native_start(next)==ESP_ERR_INVALID_STATE);
    assert(esp32qjs_wps_native_close(next)==ESP_OK && !disconnect_calls);
    fixture_dispose();
    for(unsigned stage=0;stage<ESP32QJS_WPS_CLEANUP_DONE;stage++) {
        next=0;assert(esp32qjs_wps_native_begin(&config,&next)==ESP_OK);
        assert(esp32qjs_wps_native_start(next)==ESP_OK);
        cleanup_fail_stage=stage;
        assert(esp32qjs_wps_native_close(next)!=ESP_OK);
        assert(s_wps_native->status.cleanup_stage==stage && !s_wps_native->status.inputs_stopped);
        assert(esp32qjs_wps_native_retire_state(next)==ESP_ERR_INVALID_STATE && !deinit_calls);
        unsigned before[ESP32QJS_WPS_CLEANUP_DONE];memcpy(before,cleanup_calls,sizeof(before));
        cleanup_fail_stage=-1;
        assert(esp32qjs_wps_native_close(next)==ESP_OK);
        for(unsigned prior=0;prior<stage;prior++)assert(cleanup_calls[prior]==before[prior]);
        assert(cancel_count==6 && gWpsSm && !deinit_calls);
        assert(esp32qjs_wps_native_retire_state(next)==ESP_OK && deinit_calls==1);
        fixture_dispose();
    }
    next=0;assert(esp32qjs_wps_native_begin(&config,&next)==ESP_OK);
    fail_cancel_at=3;
    assert(esp32qjs_wps_native_close(next)==-301 && s_wps_native->timers_cancelled==3);
    fail_cancel_at=UINT32_MAX;
    assert(esp32qjs_wps_native_close(next)==ESP_OK && cancel_count==6);
    s_wps_native->status.callback_depth=UINT16_MAX;
    assert(!esp32qjs_wps_callback_enter() && s_wps_native->status.tracking_fault);
    assert(s_wps_native->status.callback_depth==UINT16_MAX);
    s_wps_native->status.callback_depth=0;
    assert(esp32qjs_wps_native_retire_state(next)==ESP_ERR_INVALID_STATE && !deinit_calls);
    fixture_dispose();next=0;
    scan_storage[60]=1;
    assert(esp32qjs_wps_native_begin(&config,&next)==ESP_ERR_INVALID_STATE && !allocations);
    scan_storage[60]=0;
    assert(esp32qjs_wps_native_begin(&config,&next)==ESP_OK);
    assert(esp32qjs_wps_native_start(next)==ESP_OK);
    assert(esp32qjs_wps_native_close(next)==ESP_OK);
    assert(esp32qjs_wps_native_retire_state(next)==ESP_OK);
    uint32_t revision=UINT32_MAX;
    scan_storage[70]=1;
    assert(esp32qjs_wps_native_checkpoint(next,&revision)==ESP_ERR_NOT_FINISHED);
    scan_storage[70]=0;
    assert(esp32qjs_wps_native_checkpoint(next,&revision)==ESP_OK);
    assert(esp32qjs_wps_callback_enter());esp32qjs_wps_callback_leave();
    assert(esp32qjs_wps_native_release(next,revision)==ESP_ERR_NOT_FINISHED && allocations==1);
    assert(esp32qjs_wps_native_checkpoint(next,&revision)==ESP_OK);
    assert(esp32qjs_wps_native_release(next+1,revision)==ESP_ERR_INVALID_STATE);
    assert(esp32qjs_wps_native_release(next,revision)==ESP_OK && !allocations && !esp32qjs_wps_native_held());
    assert(esp32qjs_wps_native_release(next,revision)==ESP_ERR_INVALID_STATE);
    next=0;s_wps_native_last_identity=UINT64_MAX;
    assert(esp32qjs_wps_native_begin(&config,&next)==ESP_ERR_NO_MEM && !allocations && !next);
    return 0;
}
